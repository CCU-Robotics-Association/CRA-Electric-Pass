/dts-v1/;
/plugin/;
/ {
    fragment@1 {
        target = <&i2s0>;
        __overlay__ {
            status = "okay";
            pinctrl-0 = <&i2s_pins_pe>;
            pinctrl-names = "default";
        };
    };
};