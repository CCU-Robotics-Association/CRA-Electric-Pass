## epass_dev/buildroot-epass/board/cra/epass/scripts/kernel.its
```
/dts-v1/;
/ {
    description = "ePass boot bundle";
    #address-cells = <1>;
    images {
        kernel {
            description = "Linux zImage";
            data = /incbin/("./zImage");
            type = "kernel";
            arch = "arm";
            os = "linux";
            compression = "none";
            load = <0x80008000>;
            entry = <0x80008000>;
        };

        fdt-base {
            description = "CRA Electric Pass base";
            data = /incbin/("./dt/base/devicetree.dtb");
            type = "flat_dt";
            arch = "arm";
            compression = "none";
        };



        /* screens */


        fdt-screen-hsd {
            description = "HSD screen overlay";
            data = /incbin/("./dt/screen/hsd.dtbo");
            type = "flat_dt";
            arch = "arm";
            compression = "none";
        };
        fdt-screen-boe {
            description = "BOE screen overlay";
            data = /incbin/("./dt/screen/boe.dtbo");
            type = "flat_dt";
            arch = "arm";
            compression = "none";
        };
        fdt-screen-laowu {
            description = "Laowu screen overlay";
            data = /incbin/("./dt/screen/laowu.dtbo");
            type = "flat_dt";
            arch = "arm";
            compression = "none";
        };


        /* interfaces */
        fdt-iface-adc_pa1 {
            description = "ADC PA1 interface overlay";
            data = /incbin/("./dt/interface/adc_pa1.dtbo");
            type = "flat_dt";
            arch = "arm";
            compression = "none";
        };
        fdt-iface-adc_pa123 {
            description = "ADC PA123 interface overlay";
            data = /incbin/("./dt/interface/adc_pa123.dtbo");
            type = "flat_dt";
            arch = "arm";
            compression = "none";
        };
        fdt-iface-i2c0 {
            description = "I2C0 interface overlay";
            data = /incbin/("./dt/interface/i2c0.dtbo");
            type = "flat_dt";
            arch = "arm";
            compression = "none";
        };
        fdt-iface-i2s0_pa {
            description = "I2S0 PA interface overlay";
            data = /incbin/("./dt/interface/i2s0_pa.dtbo");
            type = "flat_dt";
            arch = "arm";
            compression = "none";
        };
        fdt-iface-i2s0_pe {
            description = "I2S0 PE interface overlay";
            data = /incbin/("./dt/interface/i2s0_pe.dtbo");
            type = "flat_dt";
            arch = "arm";
            compression = "none";
        };
        fdt-iface-spi1 {
            description = "SPI1 interface overlay";
            data = /incbin/("./dt/interface/spi1.dtbo");
            type = "flat_dt";
            arch = "arm";
            compression = "none";
        };
        fdt-iface-uart1 {
            description = "UART1 interface overlay";
            data = /incbin/("./dt/interface/uart1.dtbo");
            type = "flat_dt";
            arch = "arm";
            compression = "none";
        };
        fdt-iface-uart2 {
            description = "UART2 interface overlay";
            data = /incbin/("./dt/interface/uart2.dtbo");
            type = "flat_dt";
            arch = "arm";
            compression = "none";
        };
        fdt-iface-usbhost {
            description = "USB host interface overlay";
            data = /incbin/("./dt/interface/usbhost.dtbo");
            type = "flat_dt";
            arch = "arm";
            compression = "none";
        };
        fdt-iface-usbhs {
            description = "USB HS interface overlay";
            data = /incbin/("./dt/interface/usbhs.dtbo");
            type = "flat_dt";
            arch = "arm";
            compression = "none";
        };


        /* exts */
        fdt-ext-cardkb {
            description = "M5Stack CardKB extension overlay";
            data = /incbin/("./dt/ext/cardkb.dtbo");
            type = "flat_dt";
            arch = "arm";
            compression = "none";
        };
        fdt-ext-es8311_sound {
            description = "ES8311 sound extension overlay";
            data = /incbin/("./dt/ext/es8311_sound.dtbo");
            type = "flat_dt";
            arch = "arm";
            compression = "none";
        };
        fdt-ext-lsm6ds3_pre0.4 {
            description = "LSM6DS3 pre-0.4 extension overlay";
            data = /incbin/("./dt/ext/lsm6ds3_pre0.4.dtbo");
            type = "flat_dt";
            arch = "arm";
            compression = "none";
        };
    };
};
```

## epass_dev/buildroot-epass/package/cra_device_config/Config.in
```kconfig
config BR2_PACKAGE_CRA_DEVICE_CONFIG
	bool "cra_device_config"
	help
	  CRA-maintained v0.6 boot-overlay configuration tool.

	  https://github.com/CCU-Robotics-Association/CRA-Electric-Pass/tree/main/epass_dev/components/device-config
```

## epass_dev/buildroot-epass/package/epass_drm_app/Config.in
```kconfig
config BR2_PACKAGE_EPASS_DRM_APP
	bool "epass_drm_app"
	help
	  Electronic Pass main program.

	  https://github.com/CCU-Robotics-Association/CRA-Electric-Pass/tree/main/epass_dev/drm_app_neo
```

## epass_dev/buildroot-epass/package/epass_usb_responder/Config.in
```kconfig
config BR2_PACKAGE_EPASS_USB_RESPONDER
	bool "epass_usb_responder"
	help
	  CRA Electric Pass FunctionFS file-transfer and management service.

	  https://github.com/CCU-Robotics-Association/CRA-Electric-Pass/tree/main/epass_dev/components/usb-responder
```

## epass_dev/buildroot-epass/package/epassctl/Config.in
```kconfig
config BR2_PACKAGE_EPASSCTL
	bool "epassctl"
	help
	  CRA Electric Pass command-line client for the local main-display
	  IPC service.

	  https://github.com/CCU-Robotics-Association/CRA-Electric-Pass/tree/main/epass_dev/components/epassctl
```

## epass_dev/buildroot-epass/package/libcedarx/Config.in
```kconfig
config BR2_PACKAGE_LIBCEDARX
	depends on BR2_PACKAGE_LIBCEDARC
	depends on BR2_PACKAGE_OPENSSL
	bool "libcedarx"
	help
		Third-party Allwinner CedarX multimedia middleware. This is an
		external dependency and is not maintained or authored by CRA.

		https://github.com/rhodesepass/libcedarx

comment "libcedarx needs libcedarc"
	depends on !BR2_PACKAGE_LIBCEDARC
```

## epass_dev/buildroot-epass/package/srgn_config/Config.in
```kconfig
config BR2_PACKAGE_SRGN_CONFIG
	bool "srgn_config"
	help
	  Shirogane Config is a raspi-config like tool
	  to configure device tree in epass devices.

	  https://github.com/rhodesepass/srgn_config
```
