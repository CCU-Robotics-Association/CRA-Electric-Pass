/dts-v1/;
/plugin/;
/ {
    fragment@1 {
        target = <&i2c0>;
        __overlay__ {
            cardkb:cardkb@5f {
                compatible = "m5stack,cardkb";
                reg = <0x5f>;
                polling-interval = <50>;
            };
        };
    };
};